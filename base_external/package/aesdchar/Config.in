## base_external/package/aesdchar/Config.in
```kconfig
config BR2_PACKAGE_AESDCHAR
	bool "aesdchar"
	help
	  aesdchar driver from repo 3.
```

## base_external/package/ldd-repo/Config.in
```kconfig
config BR2_PACKAGE_LDD_REPO
	bool "ldd-repo"
	help
	  Stuff from ldd repo for Assignment 7-2.
```
